## main/Kconfig.projbuild
```kconfig
menu "esp32s3GUI Display Configuration"

    choice ESP32S3GUI_DISPLAY
        prompt "Select display type"
        default ESP32S3GUI_DISPLAY_ST7796_480x320
        help
            Select the target display hardware. The choice affects
            driver initialization and layout proportions (compile-time).

        config ESP32S3GUI_DISPLAY_STUB
            bool "Stub (printf to terminal, no physical display)"

        config ESP32S3GUI_DISPLAY_ILI9341_320x240
            bool "ILI9341 320x240 (landscape, SPI)"

        config ESP32S3GUI_DISPLAY_ST7789_240x240
            bool "ST7789 240x240 (square, SPI)"

        config ESP32S3GUI_DISPLAY_GC9A01_240x240
            bool "GC9A01 240x240 (round, SPI)"

        config ESP32S3GUI_DISPLAY_ST7796_480x320
            bool "ONX3248G035 – ST7796 480x320 landscape (Nextion 3.5\")"

    endchoice

    config ESP32S3GUI_DISPLAY_WIDTH
        int
        default 0   if ESP32S3GUI_DISPLAY_STUB
        default 320 if ESP32S3GUI_DISPLAY_ILI9341_320x240
        default 240 if ESP32S3GUI_DISPLAY_ST7789_240x240
        default 240 if ESP32S3GUI_DISPLAY_GC9A01_240x240
        default 480 if ESP32S3GUI_DISPLAY_ST7796_480x320

    config ESP32S3GUI_DISPLAY_HEIGHT
        int
        default 0   if ESP32S3GUI_DISPLAY_STUB
        default 240 if ESP32S3GUI_DISPLAY_ILI9341_320x240
        default 240 if ESP32S3GUI_DISPLAY_ST7789_240x240
        default 240 if ESP32S3GUI_DISPLAY_GC9A01_240x240
        default 320 if ESP32S3GUI_DISPLAY_ST7796_480x320

endmenu

menu "esp32s3GUI Orientation"

    config ESP32S3GUI_FORCE_PORTRAIT
        bool "Force portrait orientation (ONX3248G035 test)"
        default n
        depends on ESP32S3GUI_DISPLAY_ST7796_480x320
        help
            TEST ONLY. Boots the ONX3248G035 panel in portrait (320x480)
            instead of native landscape (480x320). Display and touch use the
            same orientation constants (bsp_onx_pinmap.h).

endmenu

menu "esp32s3GUI Theme"

    choice ESP32S3GUI_THEME
        prompt "UI color theme (skin)"
        default ESP32S3GUI_THEME_DARK
        help
            Compile-time UI palette. Add new options here and matching colors
            in ui_theme.c when benchmarking additional skins.

        config ESP32S3GUI_THEME_DARK
            bool "Dark (default)"

        config ESP32S3GUI_THEME_LIGHT
            bool "Light"

    endchoice

endmenu
```

## sdkconfig.defaults
```kconfig
# esp32s3GUI - sdkconfig.defaults

# --- Target (wymagane przed pierwszym buildem) ---
CONFIG_IDF_TARGET="esp32s3"

# --- Flash ---
CONFIG_ESPTOOLPY_FLASHSIZE="16MB"
CONFIG_ESPTOOLPY_FLASHSIZE_16MB=y
CONFIG_ESPTOOLPY_FLASHMODE_QIO=y
CONFIG_ESPTOOLPY_FLASHFREQ_80M=y

# --- Partition table ---
CONFIG_PARTITION_TABLE_CUSTOM=y
CONFIG_PARTITION_TABLE_CUSTOM_FILENAME="partitions.csv"

# --- FreeRTOS ---
CONFIG_FREERTOS_UNICORE=n
CONFIG_FREERTOS_HZ=1000

# --- Task Watchdog ---
CONFIG_ESP_TASK_WDT_EN=y
CONFIG_ESP_TASK_WDT_INIT=y
CONFIG_ESP_TASK_WDT_TIMEOUT_S=10
CONFIG_ESP_TASK_WDT_CHECK_IDLE_TASK_CPU0=y
CONFIG_ESP_TASK_WDT_CHECK_IDLE_TASK_CPU1=y

# --- Logging ---
CONFIG_LOG_DEFAULT_LEVEL_INFO=y

# --- PSRAM (ESP32-S3 N16R8) ---
CONFIG_SPIRAM=y
CONFIG_SPIRAM_MODE_OCT=y
CONFIG_SPIRAM_SPEED_80M=y
CONFIG_SPIRAM_USE_MALLOC=y
CONFIG_SPIRAM_MALLOC_ALWAYSINTERNAL=16384

# --- LVGL v9 ---
CONFIG_LV_COLOR_DEPTH_16=y
CONFIG_LV_USE_LOG=y
CONFIG_LV_LOG_LEVEL_INFO=y
CONFIG_LV_FONT_MONTSERRAT_14=y
CONFIG_LV_FONT_MONTSERRAT_16=y
CONFIG_LV_FONT_MONTSERRAT_20=y
CONFIG_LV_FONT_MONTSERRAT_24=y
CONFIG_LV_BUILD_EXAMPLES=n
CONFIG_LV_BUILD_DEMOS=n
CONFIG_LV_USE_BUILTIN_MALLOC=y
CONFIG_LV_MEM_SIZE_KILOBYTES=64
CONFIG_LV_USE_TILEVIEW=y

# --- Display (ONX3248G035 / ST7796 480x320) ---
CONFIG_ESP32S3GUI_DISPLAY_ST7796_480x320=y
CONFIG_ESP32S3GUI_DISPLAY_WIDTH=480
CONFIG_ESP32S3GUI_DISPLAY_HEIGHT=320

# --- Theme ---
CONFIG_ESP32S3GUI_THEME_DARK=y
```
